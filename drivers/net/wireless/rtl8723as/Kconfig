## drivers/net/wireless/rtl8723as/Kconfig
```kconfig
config RTL8723AS
	tristate "Realtek 8723A SDIO WiFi"
	default m
	---help---
	  Help message of RTL8723AS
```

## drivers/sunxi_gpio/Kconfig
```kconfig
#
# GPIO_SW configuration
#

menuconfig NEW_GPIO
	bool "GPIO_SW support"
	default y
	help
		this a module which control single of our board`s gpio

if NEW_GPIO

config GPIO_SW_CLASS
	bool "gpio class  Support"
	default y

comment "GPIO_SW drivers"
config GPIO_SW
	tristate "gpio support for the sw"
	depends on NEW_GPIO
	depends on GPIO_SW_CLASS
	default m	
endif # GPIO_SW

menuconfig NEW_TEST_GPIO
	bool "NEW_GPIO_TEST_SW support"
	default y
	help
		this a module which control single of our board`s gpio

if NEW_TEST_GPIO

config GPIO_TEST_SW_CLASS
	bool "gpio class  Support"
	default y

comment "GPIO_TEST_SW drivers"
config GPIO_TEST_SW
	tristate "gpio support for the sw"
	depends on NEW_TEST_GPIO
	depends on GPIO_TEST_SW_CLASS
	default m
endif # NEW_TEST_GPIO
```
